## sdkconfig.defaults
```kconfig
#
# 立创实战派 ESP32-S3 (N16R8) — 相机应用
# 每个选项的理由/出处见 ~/camera-app/FACTS.md；改之前先看那张表。
#
CONFIG_IDF_TARGET="esp32s3"

# ---- Flash: 16 MB ----
CONFIG_ESPTOOLPY_FLASHSIZE_16MB=y
CONFIG_ESPTOOLPY_FLASHSIZE="16MB"
CONFIG_PARTITION_TABLE_CUSTOM=y
CONFIG_PARTITION_TABLE_CUSTOM_FILENAME="partitions.csv"

# ---- PSRAM: 8 MB octal, 80 MHz (N16R8) ----
CONFIG_SPIRAM=y
CONFIG_SPIRAM_MODE_OCT=y
CONFIG_SPIRAM_TYPE_AUTO=y
CONFIG_SPIRAM_SPEED_80M=y
CONFIG_SPIRAM_BOOT_INIT=y
CONFIG_SPIRAM_USE_MALLOC=y
CONFIG_SPIRAM_MALLOC_ALWAYSINTERNAL=16384
CONFIG_SPIRAM_MALLOC_RESERVE_INTERNAL=65536

# ---- CPU / RTOS ----
CONFIG_ESP_DEFAULT_CPU_FREQ_MHZ_240=y
CONFIG_FREERTOS_HZ=1000
CONFIG_ESP_MAIN_TASK_STACK_SIZE=8192

# ---- FATFS：长文件名，相机序号文件名用 ----
CONFIG_FATFS_LFN_HEAP=y
CONFIG_FATFS_MAX_LFN=255

# ---- 日志 ----
CONFIG_LOG_DEFAULT_LEVEL_INFO=y

# ---- esp32-camera 组件 ----
# GC0308 是唯一需要的传感器（FACTS §4）；SCCB 必须走新 I2C 驱动复用 I2C0（FACTS §7.1）。
CONFIG_GC0308_SUPPORT=y
CONFIG_SCCB_HARDWARE_I2C_DRIVER_NEW=y
CONFIG_GC_SENSOR_SUBSAMPLE_MODE=y
```
